#include "firework.h"
#include "oled.h"

unsigned char fireworkdata[]={
0,0,0,0,0,0,0,0,0,0,0,0,0,0,0,0,0,0,0,0,0,0,0,0,0,0,0,0,0,0,0,0,0,0,0,0,0,0,0,0,0,0,0,0,0,0,0,0,
0,0,0,0,0,0,0,0,0,0,0,0,0,0,0,0,0,0,0,0,0,0,0,0,0,0,0,0,0,0,0,0,0,0,0,0,0,0,0,0,0,0,0,0,0,0,0,0,
0,0,0,0,0,0,0,0,0,0,0,0,0,0,0,0,0,0,0,0,0,128,192,224,224,224,192,128,0,0,0,0,0,0,0,0,0,0,0,0,0,0,0,0,0,0,0,0,
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0,0,0,0,0,0,0,0,0,0,0,0,0,0,0,0,0,0,0,0,0,0,0,0,0,0,0,0,0,0,0,0,0,0,0,0,0,0,0,0,0,0,0,0,0,0,0,0,
};

void firework(int x, int y)
{
    OLED_ShowStr(6,0,"Happy New Year OvO",1);
    int xx = x + 24, yy = y + 3, yn = 6, i;
    unsigned char st = 0x80, ed = 0xff;
    for (i = 0; i < 8; i++)
    {
        OLED_SetPos(xx, 7);
        OLED_writebyte(st, OLED_DATA);
        st = (st >> 1) | 0x80;
        HAL_Delay(10);
        for (yn = 6; yn > yy; yn--)
        {
            st = 0x80;
            ed = 0x7f;
            for (i = 0; i < 8; i++)
            {
                OLED_SetPos(xx, yn);
                OLED_writebyte(st, OLED_DATA);
                OLED_SetPos(xx, yn + 1);
                OLED_writebyte(ed, OLED_DATA);
                st = (st >> 1) | 0x80;
                ed = ed >> 1;
                HAL_Delay(40 - yn * 5);
            }
        }
        st = 0x80;
        ed = 0x3f;
        for (i = 0; i < 8; i++)
        {
            OLED_SetPos(xx, yy);
            OLED_writebyte(st, OLED_DATA);
            OLED_SetPos(xx, yy + 1);
            OLED_writebyte(ed, OLED_DATA);
            st = (st >> 1) | 0x80;
            ed = ed >> 2;
            HAL_Delay(40 - yy * 5);
        }
         for (i = 0; i < 8; i++)
         {
             OLED_DrawBMP(x, y, 48, 48, &fireworkdata[i * 288]);
             if(i != 7) HAL_Delay(10);
             if(i == 7) HAL_Delay(40);
         }
    }
}
